//GROUP 19 Project E
//Kunjira = 102088859
//Aditya = 102584674
//Ishraf = 102870140
//Default password = EEE20003

#include <SPI.h>
#include <Wire.h>
#include <Adafruit_GFX.h>
#include <Adafruit_SSD1306.h>
#include <EEPROM.h>
#include <U8glib.h> 
#include <RTClib.h> 

const unsigned char PROGMEM warning0 [] = {0x00, 0x00, 0x00, 0x00, 0x00, 0x00, 0x00, 0x00, 0x00, 0x00, 0x00, 0x00, 0x00,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 0x00, 0x00};

const unsigned char PROGMEM warning1 [] = {0x00, 0x00, 0x00, 0x00, 0x00, 0x00, 0x00, 0x00, 0x00, 0x00, 0x00, 0x00, 0x00,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 0x00, 0x00};

const unsigned char PROGMEM warning2 [] = {0x00, 0x00, 0x00, 0x00, 0x00, 0x00, 0x00, 0x00, 0x00, 0x00, 0x00, 0x00, 0x00,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 0x00, 0x00};

const unsigned char PROGMEM warning3 [] = {0x00, 0x00, 0x00, 0x00, 0x00, 0x00, 0x00, 0x00, 0x00, 0x00, 0x00, 0x00, 0x00,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 0x00, 0x00};

const unsigned char PROGMEM warning4 [] = {0x00, 0x00, 0x00, 0x00, 0x00, 0x00, 0x00, 0x00, 0x00, 0x00, 0x00, 0x00, 0x00,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 0x00, 0x00};

const unsigned char PROGMEM warning5 [] = {0x00, 0x00, 0x00, 0x00, 0x00, 0x00, 0x00, 0x00, 0x00, 0x00, 0x00, 0x00, 0x00,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 0x00, 0x00};

const unsigned char PROGMEM warning6 [] = {0x00, 0x00, 0x00, 0x00, 0x00, 0x00, 0x00, 0x00, 0x00, 0x00, 0x00, 0x00, 0x00,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 0x00, 0x00};

const unsigned char PROGMEM warning7 [] = {0x00, 0x00, 0x00, 0x00, 0x00, 0x00, 0x00, 0x00, 0x00, 0x00, 0x00, 0x00, 0x00,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 0x00, 0x00};

const unsigned char PROGMEM warning8 [] = {0x00, 0x00, 0x00, 0x00, 0x00, 0x00, 0x00, 0x00, 0x00, 0x00, 0x00, 0x00, 0x00,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 0x00, 0x00};

const unsigned char PROGMEM warning9 [] = {0x00, 0x00, 0x00, 0x00, 0x00, 0x00, 0x00, 0x00, 0x00, 0x00, 0x00, 0x00, 0x00,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 0x00, 0x00};

const unsigned char PROGMEM warning10 [] = {0x00, 0x00, 0x00, 0x00, 0x00, 0x00, 0x00, 0x00, 0x00, 0x00, 0x00, 0x00, 0x00,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 0x00, 0x00};

const unsigned char PROGMEM warning11 [] = {0x00, 0x00, 0x00, 0x00, 0x00, 0x00, 0x00, 0x00, 0x00, 0x00, 0x00, 0x00, 0x00,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 0x00, 0x00};

int xx=40;
int yy=10;
int tt=0;

U8GLIB_SSD1306_128X64 u8g; //for the oled display component

RTC_DS1307 rtc; //for the real time clock component
//for temperature sensor
float BETA = 3950;
//for real time clock extraction
String strHours;
String strMins;
String strSecs; 
int secs;
int mins;
int hours;
float secsF;
float minsF;
float hoursF;
String clock;
char digitalClock[9] = {};
//for use in the analog clock logic
float totalTime;
float totalMinTime;
float totalSecTime;
int toggle = 0;


#define SCREEN_WIDTH 128
#define SCREEN_HEIGHT 64
#define OLED_RESET 0  // GPIO0
Adafruit_SSD1306 display(SCREEN_WIDTH, SCREEN_HEIGHT, &Wire, OLED_RESET);
int x = 5;
int y = 25;

const int BUTTON_PIN = 11;


int ButtonState_Previous;// =0;
int ButtonState_Current ;//=0;
int led_state;

unsigned long timePress = 0;
unsigned long timePressLimit = 0;
int clicks = 0;

int digitCount = 0;
int numPos = 0;
int numPos2 = 0;
int count =0;
int passcode=0;

int debounce = 25; 
int Time_gap = 200; // max ms between clicks for a double click event


// Other button variables
boolean buttonState = HIGH; 
boolean buttonState_prev = HIGH; 
boolean waitFor_DoubleClick = false; 
boolean Double_on = false; 
boolean singleClick = true; 
long press_downTime = -1; 
long Button_releaseTime = -1; 
boolean ignoreRelease = false; 
boolean waitForRelease = false; 
boolean check = false;  


//int Default_length = 8;
//byte add= 0;
char Default_Pass[8];
char FistTimePassword[] = {'E','E','E','2','0','0','0','3'};
//char Pass1_length = 9;

int Pass1[] = {'1','0','2','0','8','8','8','5','9'};
int Pass2[] = {'1','0','2','5','8','4','6','7','4'};
int Pass3[] = {'1','0','2','8','7','0','1','4','0'};



int password_new[34];

char S_password[34];
String Pass;
int length;
int length1;
int length2;
int length3;
String New_Pass1;
String New_Pass2; 
String New_Pass3; 
char newP1_length[9];
char newP2_length[9];
char newP3_length[9];

bool on = true;

void setup() {
  Serial.begin(115200);
  pinMode(BUTTON_PIN, INPUT);
  digitalWrite(BUTTON_PIN, HIGH);

  attachInterrupt(digitalPinToInterrupt(19), activate, RISING); //external interrupt on RED button

  display.begin(SSD1306_SWITCHCAPVCC, 0x3C);
  u8g.setFont(u8g_font_7x13);

  if (! rtc.begin()) 
  {
    Serial.println("Couldn't find RTC");
    Serial.flush();
    abort();
  }
  //press_time = millis();
  
  for(int i = 0; i < 8; i++)
  {
    EEPROM.write(i, FistTimePassword[i]);
  }

  //Pass1 position 8 to 16
  //Pass2 position 17 to 25
  //Pass3 poition 26 to 33
  for(int i = 0; i < 9; i++)
  {
    EEPROM.write(i + 8 , Pass1[i]);
    EEPROM.write(i + 17 , Pass2[i]);
    EEPROM.write(i + 26 , Pass3[i]);

  }

  for(int j = 0; j < 34; j++)
  {
    S_password[j] = EEPROM.read(j);

  }
 
}

void activate() {
  if(on == false) {
    check = true;
  }
}


void loop() {
  
    while(on == true)
    {

    Serial.println("Enter System Password: ");   
    while(Serial.available() == 0){}
    Pass = Serial.readString();
  
    length = Pass.length();
    Default_Pass[length];
    Pass.toCharArray(Default_Pass, length);

    int byteOfArray = sizeof(Default_Pass);
    for(int index = 0; index < byteOfArray; index++)
    {
      Serial.print(Default_Pass[index]);
    }
    Serial.println();
    Serial.println("----------------------");  

    if((char) Default_Pass[0] == (char) EEPROM.read(0) && (char) Default_Pass[1] == (char) EEPROM.read(1) && (char) Default_Pass[2] == (char) EEPROM.read(2) && (char) Default_Pass[3] == (char) EEPROM.read(3) && (char) Default_Pass[4] == (char) EEPROM.read(4) && (char) Default_Pass[5] == (char) EEPROM.read(5) && (char) Default_Pass[6] == (char) EEPROM.read(6) && (char) Default_Pass[7] == (char) EEPROM.read(7))
    {
      Serial.println("ACCESS GRANTED");
      Serial.println("WELCOME");
      on = false;
    }
    else
    {
      Serial.println("ACCESS DENIED");
      on = true;
    }  
    } 

    Serial.println();
    Serial.println("----------------------");

    printMenu();
    while(Serial.available() > 0) 
      Serial.read();


    while(Serial.available() == 0){}
    int inByte = Serial.parseInt();

    switch (inByte) {

      case 1:
        function1();

        break;

      case 2:
        function2();
        
        break;
    }

    while(check == true)  {
      function3();
    }

}

void clickEvent()
{
    digitCount++;
    numPos++;
    display.clearDisplay();
    display.setTextSize(1);
    display.setTextColor(WHITE);
    display.setCursor(x,y);
    display.println(digitCount);
    display.display();
}

void doubleClickEvent()
{
    display.clearDisplay();
    display.setTextSize(1);
    display.setTextColor(WHITE);
    display.setCursor(x,y);
    display.println("Digit Selected");
    display.display();

    delay(1000);

    display.clearDisplay();
    display.setTextSize(1);
    display.setTextColor(WHITE);
    display.setCursor(5,35);
    display.print(numPos);
    display.display();
    delay(1000);

    numPos2 = numPos;


    if(numPos2 == (char) EEPROM.read(10))
      {
        display.clearDisplay();
        display.setTextSize(1);
        display.setTextColor(WHITE);
        display.setCursor(5,35);
        display.print("Kunjira");
        display.display();
        delay(1000);
      }

      else if(numPos2 == (char) EEPROM.read(20))
      {
        display.clearDisplay();
        display.setTextSize(1);
        display.setTextColor(WHITE);
        display.setCursor(5,35);
        display.print("Aditya");
        display.display();
      delay(1000);
      }

      else if(numPos2 == (char) EEPROM.read(29))
      {
        display.clearDisplay();
        display.setTextSize(1);
        display.setTextColor(WHITE);
        display.setCursor(5,35);
        display.print("Ishraf");
        display.display();
        delay(1000);
      }
      else
      {
        display.clearDisplay();
      display.drawBitmap(xx, yy,warning0,48,48, 1);
      display.display();
      delay(tt);

      display.clearDisplay();
      display.drawBitmap(xx, yy,warning1,48,48, 1);
      display.display();
      delay(tt);

      display.clearDisplay();
      display.drawBitmap(xx, yy,warning2,48,48, 1);
      display.display();
      delay(tt);

      display.clearDisplay();
      display.drawBitmap(xx, yy,warning3,48,48, 1);
      display.display();
      delay(tt);

      display.clearDisplay();
      display.drawBitmap(xx, yy,warning4,48,48, 1);
      display.display();
      delay(tt);

      display.clearDisplay();
      display.drawBitmap(xx, yy,warning5,48,48, 1);
      display.display();
      delay(tt);

      display.clearDisplay();
      display.drawBitmap(xx, yy,warning6,48,48, 1);
      display.display();
      delay(tt);

      display.clearDisplay();
      display.drawBitmap(xx, yy,warning7,48,48, 1);
      display.display();
      delay(tt);

      display.clearDisplay();
      display.drawBitmap(xx, yy,warning8,48,48, 1);
      display.display();
      delay(tt);

      display.clearDisplay();
      display.drawBitmap(xx, yy,warning9,48,48, 1);
      display.display();
      delay(tt);

      display.clearDisplay();
      display.drawBitmap(xx, yy,warning10,48,48, 1);
      display.display();
      delay(tt);

      display.clearDisplay();
      display.drawBitmap(xx, yy,warning11,48,48, 1);
      display.display();
      delay(1000);

        display.clearDisplay();
        display.setTextSize(1);
        display.setTextColor(WHITE);
        display.setCursor(5,35);
        display.print("Error");
        display.display();
        delay(1000);
      }

    
    }

int checkButton()
{
  int event = 0;
  buttonState = digitalRead(BUTTON_PIN);

  if(buttonState == LOW && buttonState_prev == HIGH && (millis() - Button_releaseTime) > debounce)
  {
    press_downTime = millis();
    ignoreRelease = false;
    waitForRelease = false;
    singleClick = true;


    if((millis() - Button_releaseTime) < Time_gap && Double_on == false && waitFor_DoubleClick == true)
    {
      Double_on = true;
    }
    else 
    {
      Double_on = false;
      waitFor_DoubleClick = false;
    }
    }
    else if(buttonState == HIGH && buttonState_prev == LOW && (millis() - press_downTime) > debounce)
    {
      if(!ignoreRelease)
      {
        Button_releaseTime = millis();
        if(Double_on == false) 
        {
          waitFor_DoubleClick = true;
        }
        else
        {
          event = 2;
          Double_on = false;
          waitFor_DoubleClick  = false;
          singleClick = false;
        }
      }
    }

    if(buttonState == HIGH && (millis()-Button_releaseTime) >= Time_gap && waitFor_DoubleClick == true && Double_on == false && singleClick == true)
    {
      event = 1;
      waitFor_DoubleClick = false;
    }

    buttonState_prev = buttonState;
    return event;
}


void printMenu(){

//Print main menu
Serial.println("ACCESS CONTROL SYSTEM MENU");
Serial.println("------------------------");
Serial.println("OPTION 1 - Update Member Passcodes in EEPROM");
Serial.println("OPTION 2 - Display Data From Additional Sensors");
Serial.println("OPTION 3 - Activate Access Control System (~PRESS THE RED BUTTON AND THEN PRESS ENTER INTO THE SERIAL MONITOR~)");
Serial.println("------------------------");

}

void function1(){

Serial.println(">> Option 1 Selected - Update Member Passcodes in EEPROM");

Serial.println("Enter New Password 1: "); 
    while(Serial.available() > 0) 
      Serial.read();  
    while(Serial.available() == 0){}
    New_Pass1 = Serial.readString();

    length1 = New_Pass1.length();
    newP1_length[length1];
    New_Pass1.toCharArray(newP1_length, length1);

    for(int index = 0; index < 9; index++)
    {
      Serial.print(New_Pass1[index]);
    }
    Serial.println();

    Serial.println("Enter New Password 2: ");   
    while(Serial.available() == 0){}
    New_Pass2 = Serial.readString();

    length2 = New_Pass2.length();
    newP2_length[length2];
    New_Pass2.toCharArray(newP2_length, length2);

    for(int index = 0; index < 9; index++)
    {
      Serial.print(New_Pass2[index]);
    }
    Serial.println();

    Serial.println("Enter New Password 3: ");   
    while(Serial.available() == 0){}
    New_Pass3 = Serial.readString();

    length3 = New_Pass3.length();
    newP3_length[length3];
    New_Pass3.toCharArray(newP3_length, length3);

    for(int index = 0; index < 9; index++)
    {
      Serial.print(New_Pass3[index]);
    }
    Serial.println();
    Serial.println();


for(int i = 0; i < 9; i++)
  {
    EEPROM.update(i+ 8, New_Pass1[i]);
    EEPROM.update(i + 17 , New_Pass2[i]);
    EEPROM.update(i + 26 , New_Pass3[i]);

  }

  Serial.print("New Password 1: ");
 for(int j = 8; j < 17; j++)
  {
    password_new[j] = EEPROM.read(j) - '0';
    Serial.print(password_new[j]);
  }
  Serial.println();

 Serial.print("New Password 2: ");
 for(int j = 17; j < 26; j++)
  {
    password_new[j] = EEPROM.read(j) - '0';
    Serial.print(password_new[j]);
  }
  Serial.println();

Serial.print("New Password 3: ");
 for(int j = 26; j < 35; j++)
  {
    password_new[j] = EEPROM.read(j) - '0';
    Serial.print(password_new[j]);
  }
  Serial.println();


}
void function2()
{

Serial.println(">> Option 2 Selected - Time and Temperature Data Display");

  timeNow(); //calls the time function created above
  //converting digital clock string variable into a character array
  clock.toCharArray(digitalClock, 9);
  int r = 30;
  int rHourHand = 15;

  u8g.firstPage();
  do {
    u8g.setColorIndex(1); //colour is white

    //if the button hass toggle to the 1st state or has been toggled 
    //above the last state, digital clock is displayed
    
      u8g.drawStr(36, 20, digitalClock); //digital clock display
      u8g.drawFrame(34, 8, 60, 16); //digital clock frame
      toggle = 0;
      int analogValue = analogRead(A1);
      float celsius = 1 / (log(1 / (1023. / analogValue - 1)) / BETA + 1.0 / 298.15) - 273.15;

      String strCelsius = String(celsius,1);
      char celsiusC = 'C';
      strCelsius = strCelsius + char(176);
      char charCelsius[strCelsius.length()];
      strCelsius.toCharArray(charCelsius, strCelsius.length()+1);
      charCelsius[strCelsius.length()] = celsiusC;
      
      u8g.drawStr(36, 45, charCelsius); //alarm clock display
    
  }while ( u8g.nextPage() );
  u8g.setColorIndex(1);

}

void function3()
{

Serial.println(">> Option 3 Selected - Access Control System");

while(digitCount < 10)
{

    display.clearDisplay();
    display.setTextSize(1);
    display.setTextColor(WHITE);
    display.setCursor(x,y);
    display.println(digitCount);
    display.display();

    ButtonState_Current = digitalRead(BUTTON_PIN);
    int b = checkButton();

    if(b == 1)
    {
      clickEvent();
    }
    if(b == 2)
    {
      doubleClickEvent();
      
    }
      
    if(digitCount == 10)
    {
      digitCount = 0;
    }
    if(numPos == 10)
    {
      numPos = 0;
    }

}
}

void timeNow() {
  DateTime now = rtc.now(); //get the current time
  
  strSecs = now.second(); //extract real time seconds into string
  strMins = now.minute(); //extract real time minutes into string
  strHours = now.hour();  //extract real time hours into string

  //conversion of string to integer
  secs = strSecs.toInt(); 
  mins = strMins.toInt();
  hours = strHours.toInt();

  //converting integers to floats shited down 1 decimal place
  secsF = secs * 0.1;
  minsF = mins * 0.1;
  hoursF = hours * 0.1;

  //for if the time value is a single digit a 0 is added before it
  if ((hours >= 0) && (hours < 10)) {
    strHours = "0" + strHours;
  }
  if ((mins >= 0) && (mins < 10)) {
    strMins = "0" + strMins;
  }
  if ((secs >= 0) && (secs < 10)) {
    strSecs = "0" + strSecs;
  }

  //digital time of the clock
  clock = strHours + ":" + strMins + ":" + strSecs;

  //total seconds in 12 hours = 43200;
  //int variable cant handle numbers over 32,767;
  //so had to deal with the total seconds in float shifted down one decimal.
  if (hours >= 12) {
    totalTime = secsF + (minsF * 60) + ((hoursF - 1.2) * 60 * 60);
  }
  else {
    totalTime = secsF + (minsF * 60) + (hoursF * 60 * 60);
  }

  //total seconds in 1 hour = 3600
  totalMinTime = secs + (mins * 60);

  //total seconds in 1 minute = 60
  totalSecTime = secs;

}
